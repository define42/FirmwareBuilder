## br2-external/Config.in
```kconfig
menu "MYFW external options"
source "$BR2_EXTERNAL_MYFW_PATH/package/Config.in"
endmenu
```

## br2-external/configs/myfw_x86_64_rauc_defconfig
```kconfig
BR2_x86_64=y
BR2_TOOLCHAIN_BUILDROOT_GLIBC=y
BR2_ROOTFS_DEVICE_CREATION_DYNAMIC_EUDEV=y

BR2_TARGET_GENERIC_HOSTNAME="myfw"
BR2_TARGET_GENERIC_ISSUE="MyFW Appliance with RAUC"

BR2_ROOTFS_OVERLAY="$(BR2_EXTERNAL_MYFW_PATH)/board/myfw/overlay"
BR2_ROOTFS_POST_BUILD_SCRIPT="$(BR2_EXTERNAL_MYFW_PATH)/board/myfw/post-build.sh"
BR2_ROOTFS_POST_IMAGE_SCRIPT="$(BR2_EXTERNAL_MYFW_PATH)/board/myfw/post-image.sh"

BR2_LINUX_KERNEL=y
BR2_LINUX_KERNEL_USE_DEFCONFIG=y
BR2_LINUX_KERNEL_DEFCONFIG="x86_64"
BR2_LINUX_KERNEL_CONFIG_FRAGMENT_FILES="$(BR2_EXTERNAL_MYFW_PATH)/board/myfw/linux.fragment"
BR2_LINUX_KERNEL_INSTALL_TARGET=y
BR2_LINUX_KERNEL_NEEDS_HOST_LIBELF=y

BR2_TARGET_GRUB2=y
BR2_TARGET_GRUB2_X86_64_EFI=y
BR2_TARGET_GRUB2_BUILTIN_MODULES_EFI="boot linux ext2 fat part_gpt normal efi_gop loadenv echo test"
BR2_TARGET_GRUB2_INSTALL_TOOLS=y

BR2_PACKAGE_BUSYBOX=y
BR2_PACKAGE_DROPBEAR=y
BR2_PACKAGE_NETFORGE=y
BR2_PACKAGE_RAUC=y

BR2_TARGET_ROOTFS_EXT2=y
BR2_TARGET_ROOTFS_EXT2_4=y
BR2_TARGET_ROOTFS_EXT2_SIZE="256M"

BR2_PACKAGE_HOST_DOSFSTOOLS=y
BR2_PACKAGE_HOST_GENIMAGE=y
BR2_PACKAGE_HOST_MTOOLS=y
BR2_PACKAGE_HOST_RAUC=y
```

## br2-external/package/netforge/Config.in
```kconfig
config BR2_PACKAGE_NETFORGE
	bool "netforge"
	depends on BR2_x86_64
	help
	  Install the prebuilt NetForge linux/amd64 release binary.

	  The package also installs a SysV init script so NetForge starts
	  automatically at boot and reads its runtime settings from
	  /etc/default/netforge.

comment "netforge needs an x86_64 target"
	depends on !BR2_x86_64
```
